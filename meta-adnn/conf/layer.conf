## meta-adnn/conf/layer.conf
```bitbake
# We have a conf and classes directory, add to BBPATH
BBPATH .= ":${LAYERDIR}"

# We have recipes-* directories, add to BBFILES
BBFILES += "${LAYERDIR}/recipes-*/*/*.bb \
            ${LAYERDIR}/recipes-*/*/*.bbappend"

BBFILE_COLLECTIONS += "meta-adnn"
BBFILE_PATTERN_meta-adnn = "^${LAYERDIR}/"
BBFILE_PRIORITY_meta-adnn = "6"

LAYERDEPENDS_meta-adnn = "core"
LAYERSERIES_COMPAT_meta-adnn = "kirkstone"
```
